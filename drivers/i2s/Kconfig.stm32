## drivers/i2s/Kconfig.stm32
```kconfig
# STM32 I2S driver configuration options

# Copyright (c) 2018 STMicroelectronics
# SPDX-License-Identifier: Apache-2.0

menuconfig I2S_STM32
	bool "STM32 MCU I2S controller driver"
	default y
	depends on DT_HAS_ST_STM32_I2S_ENABLED
	select DMA
	help
	  Enable I2S support on the STM32 family of processors.
	  (Tested on the STM32F4 series)

if I2S_STM32

config I2S_STM32_RX_BLOCK_COUNT
	int "RX queue length"
	default 4

config I2S_STM32_TX_BLOCK_COUNT
	int "TX queue length"
	default 4

config I2S_STM32_FULL_DUPLEX
	bool "Enable full-duplex mode support on I2S"
	default n
	help
	  The board supports the I2S in full-duplex mode and can be set
	  in full-duplex mode.

config I2S_STM32_RX_OVERRUN_DROP
	bool "Drop data received in overrun context"
	default n
	help
	  Drop all data received while the IS2 driver is in overrun
	  context.

config I2S_STM32_TX_UNDERRUN_LAST_REPEAT
	bool "Send last block again in underrun context"
	default n
	help
	  Send again the last sent block while the I2S driver is in
	  underrun context.

endif # I2S_STM32
```

## subsys/fs/fcb/Kconfig
```kconfig
# Flash Circular Buffer module

# Copyright (c) 2017 Nordic Semiconductor ASA
# SPDX-License-Identifier: Apache-2.0

#
# Flash Circular Buffer
#

config FCB
	bool "Flash Circular Buffer support"
	depends on FLASH_MAP
	help
	  Enable support of Flash Circular Buffer.

if FCB

config FCB_MAX_ALIGN
	int "Maximum supported write-block alignment"
	default 8
	help
	  Specify the maximum write-block alignment, in bytes, that is
	  supported by the Flash Circular Buffer implementation. Accessing
	  through the Flash Circular Buffer subsystem a flash memory with larger
	  alignment requirement will not be possible.

endif
```
